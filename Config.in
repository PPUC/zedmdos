## Config.in
```kconfig
menu "zedmdos"
  source "$BR2_EXTERNAL_ZEDMDOS_PATH/package/zedmdos/zedmdos-initramfs/Config.in"
  source "$BR2_EXTERNAL_ZEDMDOS_PATH/package/zedmdos/zedmdos-system/Config.in"
  source "$BR2_EXTERNAL_ZEDMDOS_PATH/package/zedmdos/zedmdos-api/Config.in"
  source "$BR2_EXTERNAL_ZEDMDOS_PATH/package/zedmdos/dmd-simulator/Config.in"
  source "$BR2_EXTERNAL_ZEDMDOS_PATH/package/zedmdos/dmd-play-rust/Config.in"
  source "$BR2_EXTERNAL_ZEDMDOS_PATH/package/zedmdos/libzedmd/Config.in"
  source "$BR2_EXTERNAL_ZEDMDOS_PATH/package/zedmdos/libserum/Config.in"
  source "$BR2_EXTERNAL_ZEDMDOS_PATH/package/zedmdos/libpupdmd/Config.in"
  source "$BR2_EXTERNAL_ZEDMDOS_PATH/package/zedmdos/libdmdutil/Config.in"
  source "$BR2_EXTERNAL_ZEDMDOS_PATH/package/zedmdos/libppuc/Config.in"
  source "$BR2_EXTERNAL_ZEDMDOS_PATH/package/zedmdos/libpinmame/Config.in"
  source "$BR2_EXTERNAL_ZEDMDOS_PATH/package/zedmdos/io-boards/Config.in"
  source "$BR2_EXTERNAL_ZEDMDOS_PATH/package/zedmdos/ppuc/Config.in"
  source "$BR2_EXTERNAL_ZEDMDOS_PATH/package/zedmdos/cargs/Config.in"
  source "$BR2_EXTERNAL_ZEDMDOS_PATH/package/zedmdos/sockpp/Config.in"
  source "$BR2_EXTERNAL_ZEDMDOS_PATH/package/zedmdos/python-sdl2/Config.in"
  source "$BR2_EXTERNAL_ZEDMDOS_PATH/package/zedmdos/sdl3/Config.in"
  source "$BR2_EXTERNAL_ZEDMDOS_PATH/package/zedmdos/sdl3_image/Config.in"
endmenu
```

## configs/bcm2712_defconfig
```kconfig
# arch
BR2_aarch64=y
BR2_cortex_a76=y
BR2_ARM_FPU_NEON_FP_ARMV8=y
BR2_SHARED_STATIC_LIBS=y
BR2_STRIP_EXCLUDE_DIRS="usr/bin/dmdserver"

# kernel
BR2_KERNEL_HEADERS_AS_KERNEL=y
BR2_PACKAGE_HOST_LINUX_HEADERS_CUSTOM_6_6=y
BR2_LINUX_KERNEL=y
BR2_LINUX_KERNEL_CUSTOM_TARBALL=y
BR2_LINUX_KERNEL_CUSTOM_TARBALL_LOCATION="$(call github,raspberrypi,linux,5f674bf905525050052752646fa905adf3f60bc7)/5f674bf905525050052752646fa905adf3f60bc7.tar.gz"
BR2_LINUX_KERNEL_DEFCONFIG="bcm2712"
BR2_LINUX_KERNEL_CONFIG_FRAGMENT_FILES="$(BR2_EXTERNAL_ZEDMDOS_PATH)/board/zedmdos-bcm2712/linux-defconfig-fragment.config"
BR2_LINUX_KERNEL_DTS_SUPPORT=y
BR2_LINUX_KERNEL_INTREE_DTS_NAME="broadcom/bcm2712-rpi-5-b"
BR2_LINUX_KERNEL_LZ4=y
BR2_LINUX_KERNEL_NEEDS_HOST_OPENSSL=y

# rpi5 firmware
BR2_PACKAGE_RPI_FIRMWARE=y
BR2_PACKAGE_RPI_FIRMWARE_VARIANT_PI=y
BR2_PACKAGE_BRCMFMAC_SDIO_FIRMWARE_RPI=y
BR2_PACKAGE_BRCMFMAC_SDIO_FIRMWARE_RPI_WIFI=y

BR2_TOOLCHAIN_BUILDROOT_GLIBC=y
BR2_TOOLCHAIN_BUILDROOT_CXX=y
BR2_GLOBAL_PATCH_DIR="$(BR2_EXTERNAL_ZEDMDOS_PATH)/board/zedmdos-patches"

# system
BR2_TARGET_GENERIC_HOSTNAME="zedmdos"
BR2_TARGET_GENERIC_ISSUE="Welcome to zedmdos"
BR2_INIT_SYSV=y
BR2_ROOTFS_DEVICE_CREATION_DYNAMIC_EUDEV=y
BR2_TARGET_GENERIC_ROOT_PASSWD="linux"

# rootfs
# BR2_TARGET_GENERIC_REMOUNT_ROOTFS_RW is not set
BR2_ROOTFS_POST_IMAGE_SCRIPT="$(BR2_EXTERNAL_ZEDMDOS_PATH)/board/zedmdos-bcm2712/post-image.sh"
BR2_TARGET_ROOTFS_TAR=n
BR2_TARGET_ROOTFS_SQUASHFS=y

### packages
BR2_PACKAGE_ZEDMDOS_SYSTEM=y
BR2_PACKAGE_DMD_PLAY_RUST_DMD_PLAY_BIN=y

# gpu
BR2_PACKAGE_ZEDMDOS_RPI_MESA3D=y
```

## configs/x64_defconfig
```kconfig
# arch
BR2_x86_64=y
BR2_SHARED_STATIC_LIBS=y
BR2_STRIP_EXCLUDE_DIRS="usr/bin/dmdserver"

# kernel
BR2_LINUX_KERNEL=y
BR2_LINUX_KERNEL_CUSTOM_VERSION=y
BR2_LINUX_KERNEL_CUSTOM_VERSION_VALUE="6.14.9"
BR2_KERNEL_HEADERS_6_14=y
BR2_LINUX_KERNEL_PATCH="$(BR2_EXTERNAL_ZEDMDOS_PATH)/board/zedmdos-x64/linux_patches"
BR2_LINUX_KERNEL_USE_CUSTOM_CONFIG=y
BR2_LINUX_KERNEL_CUSTOM_CONFIG_FILE="$(BR2_EXTERNAL_ZEDMDOS_PATH)/board/zedmdos-x64/linux_x86_64-defconfig.config"
BR2_LINUX_KERNEL_CONFIG_FRAGMENT_FILES="$(BR2_EXTERNAL_ZEDMDOS_PATH)/board/zedmdos-x64/linux-defconfig-fragment.config"
BR2_LINUX_KERNEL_NEEDS_HOST_LIBELF=y
BR2_LINUX_KERNEL_NEEDS_HOST_OPENSSL=y

# firmwares
BR2_PACKAGE_LINUX_FIRMWARES=y

BR2_TOOLCHAIN_BUILDROOT_GLIBC=y
BR2_TOOLCHAIN_BUILDROOT_CXX=y
BR2_GLOBAL_PATCH_DIR="$(BR2_EXTERNAL_ZEDMDOS_PATH)/board/zedmdos-patches"

# system
BR2_TARGET_GENERIC_HOSTNAME="zedmdos"
BR2_TARGET_GENERIC_ISSUE="Welcome to zedmdos"
BR2_INIT_SYSV=y
BR2_ROOTFS_DEVICE_CREATION_DYNAMIC_EUDEV=y
BR2_TARGET_GENERIC_ROOT_PASSWD="linux"

# rootfs
# BR2_TARGET_GENERIC_REMOUNT_ROOTFS_RW is not set
BR2_ROOTFS_POST_IMAGE_SCRIPT="$(BR2_EXTERNAL_ZEDMDOS_PATH)/board/zedmdos-x64/post-image.sh"
BR2_TARGET_ROOTFS_TAR=n
BR2_TARGET_ROOTFS_SQUASHFS=y

### packages
BR2_PACKAGE_ZEDMDOS_SYSTEM=y
BR2_PACKAGE_DMD_PLAY_RUST_DMD_PLAY_BIN=y

# boot
BR2_TARGET_GRUB2=y
BR2_TARGET_GRUB2_X86_64_EFI=y
```

## package/zedmdos/dmd-simulator/Config.in
```kconfig
config BR2_PACKAGE_DMD_SIMULATOR
    bool "dmd-simulator"
    select BR2_PACKAGE_PYTHON_NUMPY
    select BR2_PACKAGE_PYTHON_PILLOW
    select BR2_PACKAGE_PYTHON_NUMPY_ARCH_SUPPORTS
    select BR2_PACKAGE_PYTHON_SDL2
    help
      dmd-simulator player command that can send image to the simulator or to the libdmd server
```

## package/zedmdos/libppuc/Config.in
```kconfig
config BR2_PACKAGE_LIBPPUC
    bool "libppuc"

    select BR2_PACKAGE_IO_BOARDS
    select BR2_PACKAGE_LIBSERIALPORT
    select BR2_PACKAGE_LIBYAML

    help
      PPUC i/o boards communication library
      
      https://github.com/PPUC/libppuc
```

## package/zedmdos/ppuc/Config.in
```kconfig
config BR2_PACKAGE_PPUC
    bool "ppuc"

    select BR2_PACKAGE_LIBDMDUTIL
    select BR2_PACKAGE_LIBPINMAME
    select BR2_PACKAGE_CARGS
    select BR2_PACKAGE_YAML_CPP
    select BR2_PACKAGE_SDL3
    select BR2_PACKAGE_SDL3_IMAGE
    select BR2_PACKAGE_LIBPPUC

    help
      Pinball Power-Up Controller
      
      https://github.com/PPUC/ppuc
```

## package/zedmdos/zedmdos-boot/Config.in
```kconfig
config BR2_PACKAGE_ZEDMDOS_BOOT
        bool "zedmdos-boot"

        select BR2_PACKAGE_JQ
	select BR2_PACKAGE_IPROUTE2

        # network
        select BR2_PACKAGE_AVAHI
        select BR2_PACKAGE_AVAHI_DAEMON
        select BR2_PACKAGE_AVAHI_LIBDNSSD_COMPATIBILITY
        select BR2_PACKAGE_CONNMAN
        select BR2_PACKAGE_CONNMAN_WIFI
        select BR2_PACKAGE_CONNMAN_CLIENT

        # wifi
        select BR2_PACKAGE_WPA_SUPPLICANT
        select BR2_PACKAGE_WPA_SUPPLICANT_CLI
        select BR2_PACKAGE_WPA_SUPPLICANT_DBUS
        select BR2_PACKAGE_WPA_SUPPLICANT_DBUS_INTROSPECTION
        select BR2_PACKAGE_WPA_SUPPLICANT_WIRED
        select BR2_PACKAGE_WPA_SUPPLICANT_WPA3
        select BR2_PACKAGE_WPA_SUPPLICANT_NL80211
        select BR2_PACKAGE_WPA_SUPPLICANT_WEXT

	# clock
	select BR2_PACKAGE_NTP
	select BR2_TARGET_TZ_INFO
```

## package/zedmdos/zedmdos-initramfs/Config.in
```kconfig
config BR2_PACKAGE_ZEDMDOS_INITRAMFS
	bool "zedmdos initramfs"
	default n
	help
	  A simple initramfs based on busybox.

	  http://busybox.net/
```

## package/zedmdos/zedmdos-system/Config.in
```kconfig
config BR2_PACKAGE_ZEDMDOS_SYSTEM
        bool "zedmdos-system"

        select BR2_PACKAGE_ZEDMDOS_INITRAMFS
        select BR2_PACKAGE_PYTHON3
        select BR2_PACKAGE_DMD_SIMULATOR
        select BR2_PACKAGE_LIBDMDUTIL
        select BR2_PACKAGE_PPUC
        select BR2_PACKAGE_ZEDMDOS_API

        # for pillow functionnalities
        select BR2_PACKAGE_FREETYPE
        select BR2_PACKAGE_DEJAVU

        # scripts
        select BR2_PACKAGE_JQ
        select BR2_PACKAGE_IPROUTE2

	# usb tools
	select BR2_PACKAGE_USBMOUNT

        # network
        select BR2_PACKAGE_AVAHI
        select BR2_PACKAGE_AVAHI_DAEMON
        select BR2_PACKAGE_AVAHI_LIBDNSSD_COMPATIBILITY
        select BR2_PACKAGE_CONNMAN
        select BR2_PACKAGE_CONNMAN_WIFI
        select BR2_PACKAGE_CONNMAN_CLIENT

        # wifi
        select BR2_PACKAGE_WPA_SUPPLICANT
        select BR2_PACKAGE_WPA_SUPPLICANT_CLI
        select BR2_PACKAGE_WPA_SUPPLICANT_DBUS
        select BR2_PACKAGE_WPA_SUPPLICANT_DBUS_INTROSPECTION
        select BR2_PACKAGE_WPA_SUPPLICANT_WIRED
        select BR2_PACKAGE_WPA_SUPPLICANT_WPA3
        select BR2_PACKAGE_WPA_SUPPLICANT_NL80211
        select BR2_PACKAGE_WPA_SUPPLICANT_WEXT

        # clock
        select BR2_PACKAGE_NTP
        select BR2_TARGET_TZ_INFO

	# usefull for devs, but disabled by default
        select BR2_PACKAGE_OPENSSH
        select BR2_PACKAGE_OPENSSH_SERVER

	# dev libs
	select BR2_PACKAGE_PYTHON_SERIAL
	select BR2_PACKAGE_PYTHON_PYYAML

	# sdl3 gpu
        select BR2_PACKAGE_SDL3
        select BR2_PACKAGE_SDL3_OPENGLES    if BR2_PACKAGE_HAS_LIBGLES
        select BR2_PACKAGE_SDL3_OPENGL      if BR2_PACKAGE_HAS_LIBGL
        select BR2_PACKAGE_SDL3_KMSDRM      if BR2_PACKAGE_HAS_LIBGBM && !BR2_PACKAGE_RPI_USERLAND

config BR2_PACKAGE_ZEDMDOS_RPI_MESA3D
        bool "batocera.linux driver mesa RPI"

        select BR2_PACKAGE_MESA3D
	select BR2_PACKAGE_MESA3D_OPENGL_ES
        select BR2_PACKAGE_MESA3D_OPENGL_EGL
        select BR2_PACKAGE_MESA3D_GALLIUM_DRIVER_VC4
        select BR2_PACKAGE_MESA3D_GALLIUM_DRIVER_V3D
```
